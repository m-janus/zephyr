## drivers/led/Kconfig.lp50xx
```kconfig
# Copyright (c) 2020 Seagate Technology LLC
# Copyright (c) 2022 Grinn
# SPDX-License-Identifier: Apache-2.0

config LP50XX
	bool "LP50XX LED controller"
	depends on I2C
	help
	  Enable driver for the Texas Instruments LP50XX I2C LED
	  controllers. Choose LP503X or LP5009 version.

if LP50XX

config LP503X
	bool "LP503X LED controller"
	depends on I2C
	help
	  Enable driver for the Texas Instruments LP5030 and LP5036 I2C LED
	  controllers. They are respectively supporting up to 10 and 12 LEDs.

config LP5009_12
	bool "LP5009/LP5012 LED controller"
	depends on I2C
	help
	  Enable driver for the Texas Instruments LP5009 and LP5012 I2C LED
	  controllers. They are respectively supporting up to 3 and 4 LEDs.

endif #LP50XX
```

## dts/bindings/led/ti,lp50xx.yaml
```yaml
# Copyright (c) 2020 Seagate Technology LLC
# SPDX-License-Identifier: Apache-2.0

description: TI LP503x LED controller node

compatible: "ti,lp50xx"

include: ["i2c-device.yaml", "led-controller.yaml"]

properties:
    max_curr_opt:
      type: boolean
      required: false
      description: |
        If enabled the maximum current output is set to 35 mA (25.5 mA else).
    log_scale_en:
      type: boolean
      required: false
      description: |
        If enabled a logarithmic dimming scale curve is used for LED brightness
        control. A linear dimming scale curve is used else.
    en_gpios:
      type: phandle-array
      required: false
      description: |
        GPIO pin connected with LP50XX EN pin. EN pin manages shutdown mode and
        enables I2C interface.

child-binding:
    properties:
        label:
          required: true
        index:
          required: true
        color-mapping:
          required: true
```

## tests/drivers/build_all/led/testcase.yaml
```yaml
common:
  tags: drivers led
  build_only: true
  platform_allow: native_posix
tests:
  drivers.led.build:
    min_ram: 32
  drivers.led.i2c.build:
    tags: led_lp50xx led_lp5009 led_lp5030
    extra_args: CONFIG_I2C=y CONFIG_LP50XX=y
```
